## apps/m5dial-timer/sdkconfig.defaults
```kconfig
CONFIG_IDF_TARGET="esp32s3"
CONFIG_ESP32S3_SPIRAM_SUPPORT=y
CONFIG_SPIRAM_MODE_OCT=y
CONFIG_SPIRAM_TYPE_AUTO=y
CONFIG_SPIRAM_ALLOW_STACK_EXTERNAL_MEMORY=y
CONFIG_ESP_TASK_WDT_PANIC=y
CONFIG_FREERTOS_UNICORE=n
CONFIG_FREERTOS_USE_TRACE_FACILITY=y
CONFIG_FREERTOS_GENERATE_RUN_TIME_STATS=y
CONFIG_FREERTOS_IDLE_TASK_STACKSIZE=4096
CONFIG_LV_CONF_SKIP=y
CONFIG_LV_TICK_CUSTOM=n
CONFIG_LV_TICK_CUSTOM_INCLUDE=""
CONFIG_BOOTLOADER_LOG_LEVEL_INFO=y
CONFIG_PARTITION_TABLE_SINGLE_APP=y
CONFIG_PARTITION_TABLE_FILENAME="partitions.csv"
```
